/******************************************************************
 * Programa que genera una onda senoidal usando una red neuronal
 * MLP superficial
 * Autor:
 *      Jesús Alfonso López 
 *      jalopez@uao.edu.co
 ******************************************************************/

#include <math.h>

/******************************************************************
 * Definición estructura de la red
 ******************************************************************/

const int HiddenNodes = 10;
const int InputNodes = 4;
const int OutputNodes = 1;
const int DataVal = 50;
int Samples=0;

// Los pesos de la red fueron obtenidos en TensorFlow y se copiaron a este programa
// Pesos capa oculta
const float HiddenWeights[HiddenNodes][InputNodes+1]= {
{-0.9525454044342041, -0.0009335255017504096,  -3.372152805328369,  0.03238999471068382, 12.462760925292969},
{-0.4058261811733246, 0.3421765863895416,  -2.075134515762329,  -0.5508534908294678, -0.0094069205224514},
{1.5959241390228271,  -0.05908389762043953,  1.0366990566253662,  -0.03679368644952774,  -3.4928066730499268},
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{-0.8691045045852661, -0.1131659522652626, -0.40456104278564453,  1.2054157257080078,  1.4425396919250488}



}; 

// Pesos capa de salida
const float OutputWeights[OutputNodes][HiddenNodes+1]  = {
{6.187497615814209, 1.7991119623184204,  4.174306869506836, 2.8733344078063965,  6.656586647033691, 2.518364667892456, 1.6897099018096924,  -2.6747190952301025, -7.122068881988525,  2.3097269535064697,  1.2057197093963623

}
}; 

//Vector entrada A
const float A[1][DataVal]= {5, 5, 3, 2, 3, 3, 3, 3, 3, 3, 4, 1, 3,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 1, 1};
const float B[1][DataVal]= {4, 1, 4, 2, 1, 1, 5, 1, 1, 3, 1, 2, 3,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 2, 1};
const float C[1][DataVal]= {6, 4, 3, 4, 4, 5, 3, 3, 4, 3, 5, 5, 3,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 3, 6};
const float D[1][DataVal]= {5, 2, 1, 1, 2, 1, 1, 1, 3, 1, 4, 4, 2,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 2, 5};


float deseada[1][DataVal]={ 0.31875122,   0.99375594,  1.4999949,   0.58125305,  0.76875436,  0.5437528,   1.2999974,   4.299977,  1.0312537,   1.8999897,   0.431252,  0.58125305,  4.299977,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   4.499986,  0.8062546};
 


int i, j, p, q, r;
float Accum;
float Hidden[HiddenNodes];
float Output[OutputNodes];
float Input[InputNodes];  
 

void setup(){
  //start serial connection
  Serial.begin(9600);
}

void loop(){
  
  float Entrada;
  float Salida;
  float Tiempo;
  float des;


if (Samples<50)
{
  Input[0]=A[0][Samples];
  Input[1]=B[0][Samples];
  Input[2]=C[0][Samples];
  Input[3]=D[0][Samples];
  des=deseada[0][Samples];
  Samples=Samples+1;
}

if (Samples==50)
{
  Samples=0;
}


/******************************************************************
* Cálculo de la salida de capa oculta
******************************************************************/

    for( i = 0 ; i < HiddenNodes ; i++ ) {    
      Accum = HiddenWeights[i][InputNodes] ;
      for( j = 0 ; j < InputNodes ; j++ ) {
        Accum += HiddenWeights[i][j]*Input[j];
      }
      // función de activación sigmoidal y = 1 / (1 + exp(-x))
        Hidden[i] = (1)/(1+exp(-Accum));
     //   Hidden[i] = (exp(Accum)-exp(-Accum))/(exp(Accum)+exp(-Accum));
    }

/******************************************************************
* Cálculo de la salida de capa de salida
******************************************************************/
    for( i = 0 ; i < OutputNodes ; i++ ) {    
      Accum = OutputWeights[i][HiddenNodes] ;
      for( j = 0 ; j < HiddenNodes ; j++ ) {
        Accum +=  OutputWeights[i][j]*Hidden[j];
      }
      // función de activación lineal
        Output[i] = Accum; 

    }

Salida=Output[0];


Serial.print("Salida Red: "); 
Serial.print( Salida);    
Serial.print("  Salida Des: "); 
Serial.println( des);  

delay(50);  

}



